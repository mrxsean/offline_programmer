## main/Kconfig.projbuild
```kconfig
menu "Offline Programmer Configuration"

    menu "WiFi AP"
        config PROG_WIFI_SSID
            string "WiFi SSID"
            default "RL78-Flasher"
            help
                SSID of the WiFi hotspot created by the device.

        config PROG_WIFI_PASSWORD
            string "WiFi Password"
            default "12345678"
            help
                WPA2 password, minimum 8 characters. Leave empty for an open network.

        config PROG_WIFI_CHANNEL
            int "WiFi Channel"
            range 1 13
            default 1
    endmenu

    menu "RL78 Target Interface"
        config PROG_UART_NUM
            int "UART Port Number"
            range 0 1
            default 1

        config PROG_TOOL0_TX_GPIO
            int "TOOL0 TX GPIO"
            default 42
            help
                UART TX pin. Connect to RL78 TOOL0 through a ~1k resistor
                (ties together with RX pin for 1-wire UART mode).

        config PROG_TOOL0_RX_GPIO
            int "TOOL0 RX GPIO"
            default 44
            help
                UART RX pin. Connect directly to RL78 TOOL0.

        config PROG_RESET_GPIO
            int "RESET GPIO"
            default 43
            help
                Connect to RL78 RESET pin.

        config PROG_BAUD_RATE
            int "Programming Baud Rate"
            default 115200
            help
                One of 115200 / 250000 / 500000 / 1000000.
                115200 is the most reliable choice for 1-wire UART.

        config PROG_TARGET_VOLTAGE_X10
            int "Target VDD x10"
            range 18 55
            default 33
            help
                Target supply voltage multiplied by 10 (e.g. 33 = 3.3V).
                Reported to the target during baud rate setup.

        config PROG_FLASH_BLOCK_SIZE
            int "Flash Block Size (bytes)"
            default 1024
            help
                Erase block size of the target RL78. 1024 for most RL78 families.
    endmenu

    menu "LCD (ST7789V 320x240)"
        config PROG_LCD_SCLK_GPIO
            int "LCD SCLK GPIO"
            default 14
        config PROG_LCD_MOSI_GPIO
            int "LCD MOSI GPIO"
            default 48
        config PROG_LCD_CS_GPIO
            int "LCD CS GPIO"
            default 47
        config PROG_LCD_DC_GPIO
            int "LCD DC (RS) GPIO"
            default 21
        config PROG_LCD_RST_GPIO
            int "LCD RST GPIO"
            default 13
        config PROG_LCD_BL_GPIO
            int "LCD Backlight GPIO"
            default 12
        config PROG_LCD_PIXEL_CLOCK_HZ
            int "LCD SPI pixel clock (Hz)"
            default 40000000
    endmenu

    menu "Touch Keys (I2C)"
        config PROG_TOUCH_SDA_GPIO
            int "Touch I2C SDA GPIO"
            default 6
        config PROG_TOUCH_SCL_GPIO
            int "Touch I2C SCL GPIO"
            default 5
        config PROG_TOUCH_INT_GPIO
            int "Touch INT GPIO"
            default 4
    endmenu

    menu "Buzzer"
        config PROG_BEEP_GPIO
            int "Buzzer GPIO (passive, LEDC PWM)"
            default 37
    endmenu

    menu "STM32 SWD Interface"
        config PROG_SWD_CLK_GPIO
            int "SWDCLK GPIO"
            default 43
        config PROG_SWD_DIO_GPIO
            int "SWDIO GPIO"
            default 44
        config PROG_SWD_RST_GPIO
            int "nRESET GPIO (-1 = disabled)"
            default -1
            help
                Optional target reset line. Set to -1 to disable; software
                reset-halt (AIRCR.SYSRESETREQ) is used instead.
    endmenu

endmenu
```

## sdkconfig.defaults
```kconfig
CONFIG_IDF_TARGET="esp32c3"
CONFIG_ESPTOOLPY_FLASHSIZE_4MB=y
CONFIG_PARTITION_TABLE_CUSTOM=y
CONFIG_PARTITION_TABLE_CUSTOM_FILENAME="partitions.csv"
CONFIG_COMPILER_OPTIMIZATION_PERF=y
CONFIG_ESP_DEFAULT_CPU_FREQ_MHZ_160=y
CONFIG_PROG_TOOL0_TX_GPIO=0
CONFIG_PROG_TOOL0_RX_GPIO=1
CONFIG_PROG_RESET_GPIO=2
```
